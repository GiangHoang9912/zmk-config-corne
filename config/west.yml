## config/west.yml
```yaml
manifest:
  remotes:
    - name: zmkfirmware
      url-base: https://github.com/zmkfirmware
  projects:
    - name: zmk
      remote: zmkfirmware
      revision: bab8eb06c1637c89c10edd07ec5fdc7d63a0a372
      import: app/west.yml
  self:
    path: config
```
